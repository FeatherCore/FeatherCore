/* Device Tree Source for STM32U5 series */
/dts-v1/;

/ {
    compatible = "st,stm32u5";
    model = "STMicroelectronics STM32U5 series";
    #address-cells = <1>;
    #size-cells = <1>;

    cpus {
        #address-cells = <1>;
        #size-cells = <0>;

        cpu@0 {
            device_type = "cpu";
            compatible = "arm,cortex-m33";
            reg = <0>;
        };
    };
};
